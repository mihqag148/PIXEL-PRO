## Kconfig
```kconfig
config PIXEL_PRO_USB
    bool "PIXEL PRO ESP32-S2 USB and companion interface"
    default y if BOARD_PIXEL_PRO
```

## boards/mihqag148/pixel_pro/board.yml
```yaml
board:
  name: pixel_pro
  full_name: PIXEL PRO S2 Mini
  vendor: others
  socs:
    - name: esp32s2
```

## config/west.yml
```yaml
manifest:
  projects:
    - name: zmk
      url: https://github.com/zmkfirmware/zmk
      revision: 9ebbeff0a8b69a42f14aec022cdf16c7a107b9e0
      import: app/west.yml
    - name: zephyr
      url: https://github.com/zmkfirmware/zephyr
      revision: 10ba6d0cb38bc3d258775d27982f707599320085
      import:
        name-allowlist: [cmsis, hal_espressif, hal_xtensa, picolibc]
  self:
    path: pixel-pro
```

## dts/bindings/usb/pixel,esp32s2-usb.yaml
```yaml
description: PIXEL ESP32-S2 native full-speed DWC2 controller
compatible: "pixel,esp32s2-usb"
include: base.yaml
properties:
  reg:
    required: true
  interrupts:
    required: true
```

## firmware/idf/sdkconfig.defaults
```kconfig
CONFIG_TINYUSB_HID_COUNT=2
CONFIG_ESP_CONSOLE_NONE=y

CONFIG_ESPTOOLPY_FLASHSIZE_4MB=y
CONFIG_PARTITION_TABLE_TWO_OTA=y
```
